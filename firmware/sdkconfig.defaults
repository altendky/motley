## firmware/sdkconfig.defaults
```kconfig
# CONFIG_COMPILER_CXX_EXCEPTIONS is not set
# CONFIG_COMPILER_CXX_RTTI is not set
CONFIG_ESPTOOLPY_FLASHMODE_DIO=y
CONFIG_ESPTOOLPY_FLASHFREQ_40M=y
CONFIG_ESPTOOLPY_FLASHSIZE_4MB=y
CONFIG_PARTITION_TABLE_CUSTOM=y
CONFIG_PARTITION_TABLE_CUSTOM_FILENAME="partitions.csv"
CONFIG_BT_ENABLED=y
CONFIG_BT_NIMBLE_ENABLED=y
# CONFIG_BT_NIMBLE_EXT_ADV is not set
CONFIG_BT_NIMBLE_TRANSPORT_EVT_SIZE=70
CONFIG_OPENTHREAD_ENABLED=y
CONFIG_OPENTHREAD_SRP_CLIENT=y
CONFIG_OPENTHREAD_DNS_CLIENT=y
# CONFIG_OPENTHREAD_CLI is not set
# CONFIG_OPENTHREAD_CONSOLE_ENABLE is not set
# CONFIG_LWIP_IPV6_AUTOCONFIG is not set
CONFIG_LWIP_IPV6_NUM_ADDRESSES=8
# CONFIG_USE_MINIMAL_MDNS is not set
CONFIG_ENABLE_EXTENDED_DISCOVERY=y
# CONFIG_ENABLE_WIFI_STATION is not set
# The managed package also compiles bridge helpers requiring capacity beyond root/aggregator.
# This reserves capacity only; the application creates just endpoint zero.
CONFIG_ESP_MATTER_MAX_DYNAMIC_ENDPOINT_COUNT=3
# CONFIG_ENABLE_OTA_REQUESTOR is not set
# CONFIG_ENABLE_ESP32_FACTORY_DATA_PROVIDER is not set
CONFIG_EXAMPLE_DAC_PROVIDER=y
CONFIG_EXAMPLE_COMMISSIONABLE_DATA_PROVIDER=y
CONFIG_EXAMPLE_DEVICE_INSTANCE_INFO_PROVIDER=y
CONFIG_ENABLE_CHIP_SHELL=y
CONFIG_USE_TEST_SERIAL_NUMBER=""
CONFIG_DEVICE_VENDOR_ID=0xFFF1
CONFIG_DEVICE_PRODUCT_ID=0x8000
CONFIG_DEFAULT_DEVICE_HARDWARE_VERSION=1
CONFIG_CHIP_PROJECT_CONFIG="main/chip_project_config.h"
CONFIG_ESP_CONSOLE_USB_SERIAL_JTAG=y
CONFIG_ESP_CONSOLE_SECONDARY_NONE=y
CONFIG_ESP_MAIN_TASK_STACK_SIZE=8192
```
